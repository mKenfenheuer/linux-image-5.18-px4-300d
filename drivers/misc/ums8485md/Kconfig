## drivers/misc/ums8485md/Kconfig
```kconfig
config UMS8485MD
	tristate "UMS8485MD LCM display dupport for Lenovo PX4 and PX6 series"
	select GPIO_ICH
	help
	  This driver provides /dev/lcm and /proc/ums8485md/* interfaces to use the front facing display on Lenovo PX4 and PX6 series NAS devices.

	  To compile this driver as a module, choose M here. The module
	  will be called ums8485md.
```
